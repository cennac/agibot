// SPDX-License-Identifier: (GPL-2.0+ OR MIT)
/* Match the blue-heatsink vendor DTB: GMAC0 receives RGMII clock from PHY. */

/dts-v1/;
/plugin/;

/ {
	fragment@0 {
		target-path = "/ethernet@fe1b0000";

		__overlay__ {
			clock_in_out = "input";
		};
	};
};
